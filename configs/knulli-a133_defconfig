## configs/knulli-a133_defconfig
```kconfig
# from file knulli-board.common
# users
BR2_ROOTFS_USERS_TABLES="$(BR2_EXTERNAL_BATOCERA_PATH)/board/batocera/users.txt"

# toolchain definition
BR2_OPTIMIZE_2=y
BR2_ENABLE_LTO=y
BR2_SHARED_STATIC_LIBS=y
BR2_GCC_ENABLE_GRAPHITE=y
BR2_TOOLCHAIN_BUILDROOT_GLIBC=y
BR2_TOOLCHAIN_BUILDROOT_CXX=y
# required for utf-8
BR2_TOOLCHAIN_GLIBC_GCONV_LIBS_COPY=y
BR2_STRIP_EXCLUDE_DIRS="usr/ryujinx usr/bin/vpinball usr/share/ecwolf usr/bin/vita3k usr/bin/dmdserver"

# Allow to build GOLD linker, but do not use as default
BR2_BINUTILS_EXTRA_CONFIG_OPTIONS="--enable-gold --enable-plugins"

# prefer linux tools over busybox tools
BR2_PACKAGE_BUSYBOX=n
BR2_PACKAGE_BC=y
BR2_PACKAGE_COREUTILS=y
BR2_PACKAGE_DIFFUTILS=y
BR2_PACKAGE_DOS2UNIX=y
BR2_PACKAGE_FINDUTILS=y
BR2_PACKAGE_GAWK=y
BR2_PACKAGE_GREP=y
BR2_PACKAGE_GZIP=y
BR2_PACKAGE_IFUPDOWN=y
BR2_PACKAGE_IPUTILS=y
BR2_PACKAGE_KMOD=y
BR2_PACKAGE_KMOD_TOOLS=y
BR2_PACKAGE_LESS=y
BR2_PACKAGE_LSOF=y
BR2_PACKAGE_NCURSES=y
BR2_PACKAGE_NCURSES_TARGET_PROGS=y
BR2_PACKAGE_NETCAT=y
BR2_PACKAGE_NET_TOOLS=y
BR2_PACKAGE_NFS_UTILS=y
BR2_PACKAGE_NFS_UTILS_NFSV4=y
BR2_PACKAGE_PROCPS_NG=y
BR2_PACKAGE_PSMISC=y
BR2_PACKAGE_SED=y
BR2_PACKAGE_START_STOP_DAEMON=y
BR2_PACKAGE_SYSKLOGD=y
BR2_PACKAGE_TAR=y
BR2_PACKAGE_UNRAR=y
BR2_PACKAGE_UTIL_LINUX_AGETTY=y
BR2_PACKAGE_UTIL_LINUX_BINARIES=y
BR2_PACKAGE_UTIL_LINUX_EJECT=y
BR2_PACKAGE_UTIL_LINUX_HWCLOCK=y
BR2_PACKAGE_UTIL_LINUX_KILL=y
BR2_PACKAGE_UTIL_LINUX_LOGGER=y
BR2_PACKAGE_UTIL_LINUX_LOGIN=y
BR2_PACKAGE_UTIL_LINUX_MORE=y
BR2_PACKAGE_UTIL_LINUX_MOUNT=y
BR2_PACKAGE_UTIL_LINUX_SU=y
BR2_PACKAGE_UTIL_LINUX_FALLOCATE=y
BR2_PACKAGE_WATCHDOG=y
BR2_PACKAGE_WHICH=y

# system
BR2_TARGET_GENERIC_HOSTNAME="knulli"
BR2_TARGET_GENERIC_ISSUE="knulli"
BR2_INIT_SYSV=y
BR2_ROOTFS_DEVICE_CREATION_DYNAMIC_EUDEV=y
BR2_TARGET_GENERIC_ROOT_PASSWD="linux"
BR2_SYSTEM_ENABLE_NLS=y
BR2_ENABLE_LOCALE_WHITELIST="C ar ca cs_CZ cy cy_GB cy de en el es es_MX eu eu_ES fr fr_FR fi_FI gl_ES he hu id_ID it ja ja_JP ja ko nb nb_NO nl nn nn_NO oc oc_FR pl pt pt_PT pt_BR ru ru_RU uk uk_UA ro_RO sk_SK sv sv_SE tr vi_VN zh zh_CN zh_TW"
BR2_GENERATE_LOCALE="en_US.UTF-8 ar_YE.UTF-8 ca_ES.UTF-8 cs_CZ.UTF-8 cy_GB.UTF-8 de_DE.UTF-8 el_GR.UTF-8 en_GB.UTF-8 es_ES.UTF-8 es_MX.UTF-8 eu_ES.UTF-8 fr_FR.UTF-8 fi_FI.UTF-8 gl_ES.UTF-8 he_IL.UTF-8 hu_HU.UTF-8 id_ID.UTF-8 it_IT.UTF-8 ja_JP.UTF-8 ko_KR.UTF-8 nb_NO.UTF-8 nl_NL.UTF-8 nn_NO.UTF-8 oc_FR.UTF-8 pl_PL.UTF-8 pt_BR.UTF-8 pt_PT.UTF-8 ru_RU.UTF-8 uk_UA.UTF-8 ro_RO.UTF-8 sk_SK.UTF-8 sv_SE.UTF-8 tr_TR.UTF-8 vi_VN.UTF-8 zh_CN.UTF-8 zh_TW.UTF-8"
BR2_TARGET_TZ_INFO=y
BR2_TARGET_LOCALTIME="Europe/Paris"
# BR2_TARGET_GENERIC_REMOUNT_ROOTFS_RW is not set

# Initramfs decompression support
BR2_LINUX_KERNEL_LZ4=y

# Python choices
BR2_PACKAGE_PYTHON3_PY_PYC=y
BR2_PACKAGE_PYTHON_HASHLIB=y
BR2_PACKAGE_PYTHON3_BZIP2=y
BR2_PACKAGE_PYTHON3_XZ=y

BR2_PACKAGE_ESPEAK=y
BR2_PACKAGE_ESPEAK_AUDIO_BACKEND_ALSA=y
BR2_PACKAGE_GLIBC_UTILS=y

# disable the mosquitto broker which is on by default
BR2_PACKAGE_MOSQUITTO_BROKER=n

# System
BR2_PACKAGE_BATOCERA_SYSTEM=y
BR2_PACKAGE_BATOCERA_EXTRAS=y
BR2_PACKAGE_BATOCERA_TOOLS=y
BR2_PACKAGE_BATOCERA_ALL_SYSTEMS=y
BR2_PACKAGE_BATOCERA_LINUX_FIRMWARES=y
BR2_SYSTEM_BIN_SH_DASH=y # /bin/sh implementation; set here because a `choice` cannot be `select`ed, e.g. from batocera-system/Config.in
BR2_PACKAGE_DROPBEAR_LOCALOPTIONS_FILE="$(BR2_EXTERNAL_BATOCERA_PATH)/board/batocera/dropbear_localoptions.h"

# Disable generating rootfs tar (speedup)
BR2_TARGET_ROOTFS_TAR=n

# images
BR2_ROOTFS_POST_BUILD_SCRIPT="$(BR2_EXTERNAL_BATOCERA_PATH)/board/batocera/scripts/post-build-script.sh"
BR2_ROOTFS_POST_IMAGE_SCRIPT="$(BR2_EXTERNAL_BATOCERA_PATH)/board/batocera/scripts/post-image-script.sh"

# Batocera
#BR2_PACKAGE_BATOCERA_DEV=y
#BR2_PACKAGE_BATOCERA_DEBUG=y
#BR2_PACKAGE_BATOCERA_CORES_EXPERIMENTAL=y
BR2_PACKAGE_BATOCERA_VIDEO_CODECS=y

# Enables ccache
BR2_CCACHE=y

### from board file ###

# Target definition
BR2_aarch64=y
BR2_cortex_a53=y
BR2_ARM_FPU_NEON_FP_ARMV8=y
BR2_PACKAGE_BATOCERA_TARGET_A133=y
BR2_TARGET_OPTIMIZATION="-pipe -fsigned-char -mcpu=cortex-a53 -mtune=cortex-a53"
#BR2_TARGET_GENERIC_GETTY_PORT="tty1"
BR2_TARGET_GENERIC_GETTY_BAUDRATE_115200=y
BR2_GLOBAL_PATCH_DIR="$(BR2_EXTERNAL_BATOCERA_PATH)/board/batocera/patches $(BR2_EXTERNAL_BATOCERA_PATH)/board/batocera/allwinner/patches $(BR2_EXTERNAL_BATOCERA_PATH)/board/batocera/allwinner/a133/patches"
BR2_ROOTFS_OVERLAY="$(BR2_EXTERNAL_BATOCERA_PATH)/board/batocera/fsoverlay $(BR2_EXTERNAL_BATOCERA_PATH)/board/batocera/allwinner/a133/fsoverlay"
BR2_TARGET_ROOTFS_SQUASHFS4_GZIP=y

# batocera splash screen
#BR2_PACKAGE_BATOCERA_SPLASH_MPV=y

BR2_PACKAGE_MPV=y

# Batocera system
BR2_PACKAGE_BATOCERA_KODI20=n
#BR2_PACKAGE_BATOCERA_KODI21=n
#BR2_PACKAGE_FLATBUFFERS=y
#BR2_PACKAGE_FSTRCMP=y
#BR2_PACKAGE_LIBASS=y
#BR2_PACKAGE_LIBCROSSGUID=y
#BR2_PACKAGE_LIBDRM=y
#BR2_PACKAGE_LIBPLIST=y
#BR2_PACKAGE_SPDLOG=y
#BR2_PACKAGE_TAGLIB=y

# Bootloader
#BR2_TARGET_ARM_TRUSTED_FIRMWARE_CUSTOM_VERSION=y
#BR2_TARGET_ARM_TRUSTED_FIRMWARE_CUSTOM_VERSION_VALUE="lts-v2.10.2"
#BR2_TARGET_ARM_TRUSTED_FIRMWARE_PLATFORM="sun50i_h616"
#BR2_TARGET_ARM_TRUSTED_FIRMWARE_IMAGES="bl31.bin"
#BR2_PACKAGE_UBOOT_MULTI_H616=y

# spi flash support
#BR2_PACKAGE_MTD=y

######
# Linux headers same as kernel, a 4.9 series
BR2_LINUX_KERNEL=y
BR2_KERNEL_HEADERS_AS_KERNEL=y
BR2_LINUX_KERNEL_USE_CUSTOM_CONFIG=y
BR2_LINUX_KERNEL_CUSTOM_CONFIG_FILE="$(BR2_EXTERNAL_BATOCERA_PATH)/board/batocera/allwinner/a133/trimui-smart-pro/linux-sunxi64-legacy.config"
BR2_PACKAGE_HOST_LINUX_HEADERS_CUSTOM_4_9=y
BR2_LINUX_KERNEL_CUSTOM_VERSION_VALUE="4.9.191"
BR2_LINUX_KERNEL_VERSION="4.9.191"
BR2_KERNEL_HEADERS_VERSION=y
BR2_DEFAULT_KERNEL_VERSION="4.9.191"
BR2_PACKAGE_HOST_LINUX_HEADERS_CUSTOM_4_9=y
BR2_DEFAULT_KERNEL_HEADERS="4.9.191"
BR2_TOOLCHAIN_HEADERS_AT_LEAST="4.9"

# Filesystem
# BR2_ROOTFS_DEVICE_CREATION_DYNAMIC_MDEV=y
BR2_PACKAGE_HOST_DOSFSTOOLS=y
BR2_PACKAGE_HOST_GENIMAGE=y
BR2_PACKAGE_HOST_MTOOLS=y
BR2_PACKAGE_HOST_UBOOT_TOOLS=y

# FS
#BR2_TARGET_ROOTFS_EXT2_3=y
#BR2_TARGET_ROOTFS_EXT2_GEN=3
#BR2_TARGET_ROOTFS_EXT2_REV=1
#BR2_TARGET_ROOTFS_EXT2_LABEL="rootfs"
#BR2_TARGET_ROOTFS_EXT2_SIZE="3800M"
#BR2_TARGET_ROOTFS_EXT2_INODES=0
#BR2_TARGET_ROOTFS_EXT2_RESBLKS=5
#BR2_TARGET_ROOTFS_EXT2_MKFS_OPTIONS="-O ^64bit"
#BR2_TARGET_ROOTFS_EXT2_NONE=y

BR2_PACKAGE_POWERVR_GE8300_DRIVER=y
#BR2_STRIP_EXCLUDE_FILES="usr/lib/libpvrNULL_WSEGL.so usr/lib/libPVROCL.so usr/lib/libPVRScopeServices.so usr/lib/libsrv_um.so usr/lib/libtqvalidate.so usr/lib/libufwriter.so usr/lib/libusc.so"

BR2_PACKAGE_UTIL_LINUX_MOUNT=y

# ADB
BR2_PACKAGE_ANDROID_TOOLS=y
BR2_PACKAGE_ANDROID_TOOLS_ADBD=y

# SDL1 
BR2_PACKAGE_SDL=y
BR2_PACKAGE_SDL_FBCON=y
BR2_PACKAGE_SDL_GFX=y
BR2_PACKAGE_SDL_IMAGE=y
BR2_PACKAGE_SDL_IMAGE_BMP=y
BR2_PACKAGE_SDL_IMAGE_JPEG=y
BR2_PACKAGE_SDL_IMAGE_PNG=y
BR2_PACKAGE_SDL_SOUND=y
BR2_PACKAGE_SDL_TTF=y
BR2_PACKAGE_SDL12_COMPAT=y

# GDISK
BR2_PACKAGE_GPTFDISK=y
BR2_PACKAGE_GPTFDISK_GDISK=y
BR2_PACKAGE_GPTFDISK_SGDISK=y

# MISC
BR2_PACKAGE_PYTHON3_XZ=Y

# EXT2 SUPPORT (TO BE REMOVED)
#BR2_TARGET_ROOTFS_EXT2=y
#BR2_TARGET_ROOTFS_EXT2_3=y
#BR2_TARGET_ROOTFS_EXT2_GEN=3
#BR2_TARGET_ROOTFS_EXT2_REV=1
#BR2_TARGET_ROOTFS_EXT2_LABEL="rootfs"
#BR2_TARGET_ROOTFS_EXT2_SIZE="3300M"
#BR2_TARGET_ROOTFS_EXT2_INODES=0
#BR2_TARGET_ROOTFS_EXT2_INODE_SIZE=256
#BR2_TARGET_ROOTFS_EXT2_RESBLKS=5
#BR2_TARGET_ROOTFS_EXT2_MKFS_OPTIONS="-O ^64bit"
#BR2_TARGET_ROOTFS_EXT2_NONE=y
#BR2_PACKAGE_HOST_E2FSPROGS=y

# MANGO
#BR2_PACKAGE_BATOCERA_MANGOHUD=y
```

## configs/knulli-rk3568_defconfig
```kconfig
# from file knulli-board.common
# users
BR2_ROOTFS_USERS_TABLES="$(BR2_EXTERNAL_BATOCERA_PATH)/board/batocera/users.txt"

# toolchain definition
BR2_OPTIMIZE_2=y
BR2_ENABLE_LTO=y
BR2_SHARED_STATIC_LIBS=y
BR2_GCC_ENABLE_GRAPHITE=y
BR2_TOOLCHAIN_BUILDROOT_GLIBC=y
BR2_TOOLCHAIN_BUILDROOT_CXX=y
# required for utf-8
BR2_TOOLCHAIN_GLIBC_GCONV_LIBS_COPY=y
BR2_STRIP_EXCLUDE_DIRS="usr/ryujinx usr/bin/vpinball usr/share/ecwolf usr/bin/vita3k usr/bin/dmdserver"

# Allow to build GOLD linker, but do not use as default
BR2_BINUTILS_EXTRA_CONFIG_OPTIONS="--enable-gold --enable-plugins"

# prefer linux tools over busybox tools
BR2_PACKAGE_BUSYBOX=n
BR2_PACKAGE_BC=y
BR2_PACKAGE_COREUTILS=y
BR2_PACKAGE_DIFFUTILS=y
BR2_PACKAGE_DOS2UNIX=y
BR2_PACKAGE_FINDUTILS=y
BR2_PACKAGE_GAWK=y
BR2_PACKAGE_GREP=y
BR2_PACKAGE_GZIP=y
BR2_PACKAGE_IFUPDOWN=y
BR2_PACKAGE_IPUTILS=y
BR2_PACKAGE_KMOD=y
BR2_PACKAGE_KMOD_TOOLS=y
BR2_PACKAGE_LESS=y
BR2_PACKAGE_LSOF=y
BR2_PACKAGE_NCURSES=y
BR2_PACKAGE_NCURSES_TARGET_PROGS=y
BR2_PACKAGE_NETCAT=y
BR2_PACKAGE_NET_TOOLS=y
BR2_PACKAGE_NFS_UTILS=y
BR2_PACKAGE_NFS_UTILS_NFSV4=y
BR2_PACKAGE_PROCPS_NG=y
BR2_PACKAGE_PSMISC=y
BR2_PACKAGE_SED=y
BR2_PACKAGE_START_STOP_DAEMON=y
BR2_PACKAGE_SYSKLOGD=y
BR2_PACKAGE_TAR=y
BR2_PACKAGE_UNRAR=y
BR2_PACKAGE_UTIL_LINUX_AGETTY=y
BR2_PACKAGE_UTIL_LINUX_BINARIES=y
BR2_PACKAGE_UTIL_LINUX_EJECT=y
BR2_PACKAGE_UTIL_LINUX_HWCLOCK=y
BR2_PACKAGE_UTIL_LINUX_KILL=y
BR2_PACKAGE_UTIL_LINUX_LOGGER=y
BR2_PACKAGE_UTIL_LINUX_LOGIN=y
BR2_PACKAGE_UTIL_LINUX_MORE=y
BR2_PACKAGE_UTIL_LINUX_MOUNT=y
BR2_PACKAGE_UTIL_LINUX_SU=y
BR2_PACKAGE_UTIL_LINUX_FALLOCATE=y
BR2_PACKAGE_WATCHDOG=y
BR2_PACKAGE_WHICH=y

# system
BR2_TARGET_GENERIC_HOSTNAME="knulli"
BR2_TARGET_GENERIC_ISSUE="knulli"
BR2_INIT_SYSV=y
BR2_ROOTFS_DEVICE_CREATION_DYNAMIC_EUDEV=y
BR2_TARGET_GENERIC_ROOT_PASSWD="linux"
BR2_SYSTEM_ENABLE_NLS=y
BR2_ENABLE_LOCALE_WHITELIST="C ar ca cs_CZ cy cy_GB cy de en el es es_MX eu eu_ES fr fr_FR fi_FI gl_ES he hu id_ID it ja ja_JP ja ko nb nb_NO nl nn nn_NO oc oc_FR pl pt pt_PT pt_BR ru ru_RU uk uk_UA ro_RO sk_SK sv sv_SE tr vi_VN zh zh_CN zh_TW"
BR2_GENERATE_LOCALE="en_US.UTF-8 ar_YE.UTF-8 ca_ES.UTF-8 cs_CZ.UTF-8 cy_GB.UTF-8 de_DE.UTF-8 el_GR.UTF-8 en_GB.UTF-8 es_ES.UTF-8 es_MX.UTF-8 eu_ES.UTF-8 fr_FR.UTF-8 fi_FI.UTF-8 gl_ES.UTF-8 he_IL.UTF-8 hu_HU.UTF-8 id_ID.UTF-8 it_IT.UTF-8 ja_JP.UTF-8 ko_KR.UTF-8 nb_NO.UTF-8 nl_NL.UTF-8 nn_NO.UTF-8 oc_FR.UTF-8 pl_PL.UTF-8 pt_BR.UTF-8 pt_PT.UTF-8 ru_RU.UTF-8 uk_UA.UTF-8 ro_RO.UTF-8 sk_SK.UTF-8 sv_SE.UTF-8 tr_TR.UTF-8 vi_VN.UTF-8 zh_CN.UTF-8 zh_TW.UTF-8"
BR2_TARGET_TZ_INFO=y
BR2_TARGET_LOCALTIME="Europe/Paris"
# BR2_TARGET_GENERIC_REMOUNT_ROOTFS_RW is not set

# Initramfs decompression support
BR2_LINUX_KERNEL_LZ4=y

# Python choices
BR2_PACKAGE_PYTHON3_PY_PYC=y
BR2_PACKAGE_PYTHON_HASHLIB=y
BR2_PACKAGE_PYTHON3_BZIP2=y
BR2_PACKAGE_PYTHON3_XZ=y

BR2_PACKAGE_ESPEAK=y
BR2_PACKAGE_ESPEAK_AUDIO_BACKEND_ALSA=y
BR2_PACKAGE_GLIBC_UTILS=y

# disable the mosquitto broker which is on by default
BR2_PACKAGE_MOSQUITTO_BROKER=n

# System
BR2_PACKAGE_BATOCERA_SYSTEM=y
BR2_PACKAGE_BATOCERA_EXTRAS=y
BR2_PACKAGE_BATOCERA_TOOLS=y
BR2_PACKAGE_BATOCERA_ALL_SYSTEMS=y
BR2_PACKAGE_BATOCERA_LINUX_FIRMWARES=y
BR2_SYSTEM_BIN_SH_DASH=y # /bin/sh implementation; set here because a `choice` cannot be `select`ed, e.g. from batocera-system/Config.in
BR2_PACKAGE_DROPBEAR_LOCALOPTIONS_FILE="$(BR2_EXTERNAL_BATOCERA_PATH)/board/batocera/dropbear_localoptions.h"

# Disable generating rootfs tar (speedup)
BR2_TARGET_ROOTFS_TAR=n

# images
BR2_ROOTFS_POST_BUILD_SCRIPT="$(BR2_EXTERNAL_BATOCERA_PATH)/board/batocera/scripts/post-build-script.sh"
BR2_ROOTFS_POST_IMAGE_SCRIPT="$(BR2_EXTERNAL_BATOCERA_PATH)/board/batocera/scripts/post-image-script.sh"

# Batocera
#BR2_PACKAGE_BATOCERA_DEV=y
#BR2_PACKAGE_BATOCERA_DEBUG=y
#BR2_PACKAGE_BATOCERA_CORES_EXPERIMENTAL=y
BR2_PACKAGE_BATOCERA_VIDEO_CODECS=y

# Enables ccache
BR2_CCACHE=y

### from board file ###

# Target definition
BR2_aarch64=y
BR2_cortex_a55=y
BR2_ARM_FPU_NEON_FP_ARMV8=y
BR2_PACKAGE_BATOCERA_TARGET_RK3568=y
BR2_TARGET_OPTIMIZATION="-pipe -fsigned-char -mcpu=cortex-a55 -mtune=cortex-a55"
#BR2_TARGET_GENERIC_GETTY_PORT="tty1"
BR2_TARGET_GENERIC_GETTY_BAUDRATE_115200=y
BR2_GLOBAL_PATCH_DIR="$(BR2_EXTERNAL_BATOCERA_PATH)/board/batocera/patches $(BR2_EXTERNAL_BATOCERA_PATH)/board/batocera/rockchip/patches $(BR2_EXTERNAL_BATOCERA_PATH)/board/batocera/rockchip/rk3568/patches"
BR2_ROOTFS_OVERLAY="$(BR2_EXTERNAL_BATOCERA_PATH)/board/batocera/fsoverlay $(BR2_EXTERNAL_BATOCERA_PATH)/board/batocera/rockchip/fsoverlay $(BR2_EXTERNAL_BATOCERA_PATH)/board/batocera/rockchip/rk3568/fsoverlay $(BR2_EXTERNAL_BATOCERA_PATH)/board/batocera/rockchip/rk3568/anbernic-rgxx3/fsoverlay"

# Linux headers same as kernel, a 6.6 series
BR2_KERNEL_HEADERS_AS_KERNEL=y
BR2_PACKAGE_HOST_LINUX_HEADERS_CUSTOM_6_4=y

# Kernel
# Keep at 6.4.16 until Anbernic boot issue is adressed with later kernels
BR2_LINUX_KERNEL=y
BR2_LINUX_KERNEL_CUSTOM_VERSION=y
BR2_LINUX_KERNEL_CUSTOM_VERSION_VALUE="6.4.16"
BR2_LINUX_KERNEL_PATCH="$(BR2_EXTERNAL_BATOCERA_PATH)/board/batocera/rockchip/rk3568/linux_patches"
BR2_LINUX_KERNEL_USE_CUSTOM_CONFIG=y
BR2_LINUX_KERNEL_CUSTOM_CONFIG_FILE="$(BR2_EXTERNAL_BATOCERA_PATH)/board/batocera/rockchip/rk3568/linux-defconfig.config"
BR2_LINUX_KERNEL_CONFIG_FRAGMENT_FILES="$(BR2_EXTERNAL_BATOCERA_PATH)/board/batocera/rockchip/rk3568/linux-defconfig-fragment.config"
BR2_LINUX_KERNEL_NEEDS_HOST_OPENSSL=y

# Build the DTB from the kernel sources
BR2_LINUX_KERNEL_DTS_SUPPORT=y
BR2_LINUX_KERNEL_INTREE_DTS_NAME="rockchip/rk3566-odroid-m1s rockchip/rk3568-rock-3a rockchip/rk3568-odroid-m1 rockchip/rk3566-roc-pc rockchip/rk3566-anbernic-rg353p rockchip/rk3566-anbernic-rg353ps rockchip/rk3566-anbernic-rg353v rockchip/rk3566-anbernic-rg353vs rockchip/rk3566-anbernic-rg503"
BR2_LINUX_KERNEL_CUSTOM_DTS_PATH="$(BR2_EXTERNAL_BATOCERA_PATH)/board/batocera/rockchip/rk3568/dts/rk3566-rock-3c.dts $(BR2_EXTERNAL_BATOCERA_PATH)/board/batocera/rockchip/rk3568/dts/rk3568-firefly-roc-pc.dts $(BR2_EXTERNAL_BATOCERA_PATH)/board/batocera/rockchip/rk3568/dts/rk3566-anbernic-rg353v-v2.dts"

# Bootloader
BR2_PACKAGE_UBOOT_ROCK_3A=y
BR2_PACKAGE_UBOOT_ROCK_3C=y
BR2_PACKAGE_UBOOT_ANBERNIC_RGXX3=y
BR2_PACKAGE_UBOOT_FIREFLY_STATION_M2=y
BR2_PACKAGE_UBOOT_FIREFLY_STATION_P2=y
BR2_PACKAGE_UBOOT_ODROID_M1=y

# Odroid-M1S U-Boot
BR2_TARGET_UBOOT=y
BR2_TARGET_UBOOT_BUILD_SYSTEM_KCONFIG=y
BR2_TARGET_UBOOT_CUSTOM_VERSION=y
BR2_TARGET_UBOOT_CUSTOM_GIT=y
BR2_TARGET_UBOOT_CUSTOM_REPO_URL="https://github.com/Kwiboo/u-boot-rockchip"
BR2_TARGET_UBOOT_CUSTOM_REPO_VERSION="rk3xxx-2024.07"
BR2_TARGET_UBOOT_BOARD_DEFCONFIG="odroid-m1s-rk3566"
BR2_TARGET_UBOOT_NEEDS_PYLIBFDT=y
BR2_TARGET_UBOOT_NEEDS_OPENSSL=y
BR2_TARGET_UBOOT_NEEDS_PYELFTOOLS=y
BR2_TARGET_UBOOT_NEEDS_ROCKCHIP_RKBIN=y
BR2_PACKAGE_HOST_UBOOT_TOOLS_FIT_SUPPORT=y
BR2_PACKAGE_HOST_DOSFSTOOLS=y
BR2_PACKAGE_HOST_DTC=y
BR2_PACKAGE_HOST_GENIMAGE=y
BR2_PACKAGE_HOST_MTOOLS=y
BR2_PACKAGE_HOST_UBOOT_TOOLS=y
BR2_PACKAGE_ROCKCHIP_RKBIN=y
BR2_PACKAGE_ROCKCHIP_RKBIN_TPL_FILENAME="bin/rk35/rk3566_ddr_1056MHz_v1.21.bin"
BR2_PACKAGE_ROCKCHIP_RKBIN_BL31_FILENAME="bin/rk35/rk3568_bl31_v1.44.elf"

# System
BR2_PACKAGE_BATOCERA_KODI21=y
BR2_TARGET_ROOTFS_SQUASHFS4_ZSTD=y

# GPU
BR2_PACKAGE_BATOCERA_PANFROST_MESA3D=y
BR2_PACKAGE_BATOCERA_WAYLAND_SWAY=y

# Firmware
BR2_PACKAGE_FIRMWARE_ARMBIAN=y

# choices can be put in _defconfig files only
BR2_PACKAGE_BATOCERA_SPLASH_MPV=y
```

## package/batocera/boot/uboot-h700/Config.in
```kconfig
config BR2_PACKAGE_UBOOT_H700
    bool "uboot-h700"
    help
      uboot files for h700
```

## package/batocera/emulationstation/es-theme-anbernic/Config.in
```kconfig
config BR2_PACKAGE_ES_THEME_ANBERNIC_DC
	bool "EmulationStation theme Anbernic DC"
	help
	  https://github.com/UzuCore/es-theme-anbernic-dc
```

## package/batocera/emulationstation/es-theme-art-book-next/Config.in
```kconfig
config BR2_PACKAGE_ES_THEME_ART_BOOK_NEXT
	bool "EmulationStation theme Art Book Next (DC version)"
	help
	  https://github.com/UzuCore/es-theme-art-book-dc
```

## package/batocera/emulationstation/es-theme-knulli/Config.in
```kconfig
config BR2_PACKAGE_ES_THEME_KNULLI
	bool "EmulationStation theme Knulli (Batocera version)"
	help
	  https://github.com/symbuzzer/es-theme-knulli
```
