## package/batocera/emulators/retroarch/knulli-bezels/Config.in
```kconfig
config BR2_PACKAGE_KNULLI_BEZELS
        bool "knulli bezels"
        help
          Knulli bezels

	  https://github.com/chrizzo-hb/knulli-bezels
```

## package/batocera/utils/mangohud/Config.in
```kconfig
config BR2_PACKAGE_MANGOHUD
	bool "mangohud"
	depends on BR2_PACKAGE_WAYLAND || BR2_PACKAGE_XORG7 || BR2_PACKAGE_LIBDRM || BR2_PACKAGE_LIBMALI || BR2_PACKAGE_POWERVR_GE8300_DRIVER || BR2_PACKAGE_POWERVR_SGX544_DRIVER
	depends on BR2_PACKAGE_DBUS
	help
	  Command line tool for injecting HUD / overlay in GL/Vulkan apps

          https://github.com/flightlessmango/MangoHud
```

## package/knulli/themes/es-theme-art-book-next/Config.in
```kconfig
config BR2_PACKAGE_ES_THEME_ART_BOOK_NEXT
	bool "EmulationStation theme Art Book Next (Batocera version)"
	help
	  https://github.com/anthonycaccese/art-book-next-es
```
