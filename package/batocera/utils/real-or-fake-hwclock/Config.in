## package/batocera/utils/real-or-fake-hwclock/Config.in
```kconfig
config BR2_PACKAGE_REAL_OR_FAKE_HWCLOCK
    bool "real-or-fake-hwclock"
    help
      Use hwclock if available, otherwise fallback to fake-hwclock for timekeeping on boot and shutdown.
```

## package/knulli/firmwares/extra-firmwares/Config.in
```kconfig
config BR2_PACKAGE_EXTRA_FIRMWARES
	bool "extra firmwares"
    select BR2_PACKAGE_ALLLINUXFIRMWARES

	help
	  knulli extra linux firmwares
```
